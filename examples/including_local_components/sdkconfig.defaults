## examples/including_local_components/sdkconfig.defaults
```kconfig
#
# Production ESP32 Playground
#

#
# WiFi
#
CONFIG_PRODESP32_PLAYGROUND_SSID="SIDNET_IOT"
CONFIG_PRODESP32_PLAYGROUND_WIFI_PASSWORD="juicero2"
# end of WiFi
# end of Production ESP32 Playground
```

## examples/ota_testbed/main/Kconfig.projbuild
```kconfig
menu "Example Configuration"

    config EXAMPLE_MDNS_HOST_NAME
        string "mDNS Host Name"
        default "esp-home"
        help
            Specify the domain name used in the mDNS service.
            Note that webpage also take it as a part of URL where it will send GET/POST requests to.

    config EXAMPLE_WEB_MOUNT_POINT
        string "Website mount point in VFS"
        default "/www"
        help
            Specify the mount point in VFS.

endmenu
```

## examples/qemu_with_internet/sdkconfig.defaults
```kconfig
CONFIG_ETH_ENABLED=y
CONFIG_ETH_USE_ESP32_EMAC=y
CONFIG_ETH_USE_OPENETH=y

CONFIG_MBEDTLS_HARDWARE_AES=n
CONFIG_MBEDTLS_HARDWARE_SHA=n
CONFIG_MBEDTLS_HARDWARE_MPI=n
```

## examples/shared_components/wifi_connect/Kconfig
```kconfig
menu "Production ESP32 Playground"

    menu "WiFi"

        config PRODESP32_PLAYGROUND_SSID
        string "SSID"
        default "YOUR_SSID"
        help
            The SSID of your WiFi network

        config PRODESP32_PLAYGROUND_WIFI_PASSWORD
        string "Password"
        default "YOUR_PASSWORD"
        help
            The password to your WiFi network

    endmenu
endmenu
```
